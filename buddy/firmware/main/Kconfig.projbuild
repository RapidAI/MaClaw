## iot-agentos/main/Kconfig.projbuild
```kconfig
menu "MaClaw ESP32-S3 thin client"

choice MACLAW_BOARD
    prompt "Hardware board"
    default MACLAW_BOARD_ECHOEAR_2ST
    help
        Select the physical board. Existing EchoEar-2ST builds remain the
        default; Bread Compact uses a codec-less I2S microphone and amplifier.

    config MACLAW_BOARD_ECHOEAR_2ST
        bool "EchoEar-2ST (ST77916 + ES7210/ES8311)"

    config MACLAW_BOARD_BREAD_COMPACT_WIFI_LCD
        bool "Bread Compact Wi-Fi LCD (ST7789 + direct I2S audio)"

    config MACLAW_BOARD_FANGTANG_4G
        bool "无名星智 4G / Fangtang 4G (ESP32-S3 dual-network)"

    config MACLAW_BOARD_WAVESHARE_S3_TOUCH_AMOLED_1_75C
        bool "Waveshare ESP32-S3 Touch AMOLED 1.75C (CO5300 + CST9217)"
        help
            1.75-inch 466x466 round AMOLED board with AXP2101 PMU, CST9217
            touch and ES7210/ES8311 audio codecs. This is a distinct board
            profile; it must not share a rectangular-display configuration.
endchoice

config MACLAW_PRODUCT_ID
    string "Stable product identifier"
    default "maclaw-clawmate"
    help
        Machine-readable product family. Keep stable across firmware releases.

config MACLAW_BOARD_ID
    string "Stable board identifier"
    default "bread-compact-wifi-lcd-v1" if MACLAW_BOARD_BREAD_COMPACT_WIFI_LCD
    default "echoear-2st-r8" if MACLAW_BOARD_ECHOEAR_2ST
    default "fangtang-4g-v1" if MACLAW_BOARD_FANGTANG_4G
    default "waveshare-s3-touch-amoled-1.75c-v1" if MACLAW_BOARD_WAVESHARE_S3_TOUCH_AMOLED_1_75C
    help
        Machine-readable physical PCB/display/audio configuration. Change only
        when hardware compatibility changes, not for firmware releases.

config MACLAW_HW_REV
    string "Hardware revision"
    default "1"

config MACLAW_LAYOUT_ID
    string "Flash partition layout identifier"
    default "maclaw-s3-16m-factory-v2"
    help
        Declares the expected partition schema. The host flasher must still
        verify the real partition table read from flash before trusting this.

config MACLAW_COMPAT_ID
    string "Firmware compatibility identifier"
    default "maclaw-clawmate:bread-compact-wifi-lcd-v1:maclaw-s3-16m-factory-v2" if MACLAW_BOARD_BREAD_COMPACT_WIFI_LCD
    default "maclaw-clawmate:echoear-2st-r8:maclaw-s3-16m-factory-v2" if MACLAW_BOARD_ECHOEAR_2ST
    default "maclaw-clawmate:fangtang-4g-v1:maclaw-s3-16m-factory-v2" if MACLAW_BOARD_FANGTANG_4G
    default "maclaw-clawmate:waveshare-s3-touch-amoled-1.75c-v1:maclaw-s3-32m-factory-v1" if MACLAW_BOARD_WAVESHARE_S3_TOUCH_AMOLED_1_75C
    help
        Compact allow-list key used by the flasher after independent chip and
        partition-table verification.

config MACLAW_FIRMWARE_DISPLAY_NAME
    string "Human-readable firmware name"
    default "ClawMate / Bread Compact Wi-Fi LCD" if MACLAW_BOARD_BREAD_COMPACT_WIFI_LCD
    default "ClawMate / EchoEar-2ST R8" if MACLAW_BOARD_ECHOEAR_2ST
    default "ClawMate / 无名星智 4G" if MACLAW_BOARD_FANGTANG_4G
    default "ClawMate / Waveshare S3 Touch AMOLED 1.75C" if MACLAW_BOARD_WAVESHARE_S3_TOUCH_AMOLED_1_75C

config MACLAW_RELEASE_SEQUENCE
    int "Monotonic firmware release sequence"
    default 0
    help
        Set by protected release CI. Protocol-v2 BOOT_STATUS includes this
        value and ClawMate Maker compares it with the signed package.

if MACLAW_BOARD_FANGTANG_4G

config MACLAW_FANGTANG_MODEM_UART_PORT
    int "4G modem UART controller"
    range 0 2
    default 1
    help
        UART controller attached to the Cat.1/4G module. Native USB serial
        uses USB Serial/JTAG and does not consume this UART.

config MACLAW_FANGTANG_MODEM_UART_TX_GPIO
    int "ESP32 TX GPIO to 4G modem RX"
    default 12
    help
        The 无名星智 ML307 board routes ESP32 GPIO12 to the modem RX.

config MACLAW_FANGTANG_MODEM_UART_RX_GPIO
    int "ESP32 RX GPIO from 4G modem TX"
    default 11
    help
        The 无名星智 ML307 board routes ESP32 GPIO11 from the modem TX.

config MACLAW_FANGTANG_MODEM_UART_BAUD
    int "4G modem UART baud rate"
    default 921600

config MACLAW_FANGTANG_MODEM_APN
    string "Cellular APN"
    default ""
    help
        Leave empty when the SIM/operator accepts the modem's default PDP
        context; otherwise set the carrier APN.

config MACLAW_FANGTANG_MODEM_POWER_GPIO
    int "Optional 4G modem power-enable GPIO"
    default 21
    help
        无名星智 ML307 board requires GPIO21 high before modem detection.

config MACLAW_FANGTANG_MODEM_POWER_ACTIVE_LEVEL
    int "4G modem power-enable active level"
    range 0 1
    default 1
    depends on MACLAW_FANGTANG_MODEM_POWER_GPIO >= 0

config MACLAW_FANGTANG_MODEM_GUARD_GPIO
    int "4G modem companion-control GPIO"
    default 45
    help
        无名星智 ML307 board initializes GPIO45 as a pulldown output at low
        level before using the modem. Set to -1 only for a revised PCB that
        lacks this companion-control signal.

config MACLAW_FANGTANG_MODEM_GUARD_LEVEL
    int "4G modem companion-control level"
    range 0 1
    default 0
    depends on MACLAW_FANGTANG_MODEM_GUARD_GPIO >= 0

config MACLAW_FANGTANG_DEFAULT_4G
    bool "Use 4G when no network choice has been saved"
    default y
    help
        Mirrors the original ML307 board firmware. A GPIO0 double-click in
        the startup selection window toggles and persists the choice.

config MACLAW_FANGTANG_CHARGE_STATUS_GPIO
    int "Battery charging-status GPIO"
    default 38
    help
        The original xingzhi-cube-0.85tft-ml307 board reads GPIO38 once per
        second; high means external charging power is present. This is a status
        input only and is independent from the physical power switch.

config MACLAW_FANGTANG_BATTERY_ADC_UNIT
    int "Battery ADC unit"
    range 1 2
    default 2

config MACLAW_FANGTANG_BATTERY_ADC_CHANNEL
    int "Battery ADC channel"
    range 0 9
    default 6
    help
        Matches the original Fangtang board's ADC2 channel 6 battery divider.
        Keep this separate from MACLAW_BATTERY_ADC_GPIO, whose generic ADC1
        assumptions do not apply to this PCB.

endif

config MACLAW_WIFI_SSID
    string "Wi-Fi SSID"
    default ""

config MACLAW_WIFI_PASSWORD
    string "Wi-Fi password"
    default ""

config MACLAW_SERVER_URL
    string "MaClaw Hub base URL"
    default "https://hub.mypapers.top"
    help
        Public Hub URL reachable by the ESP32-S3. Do not include /api/v1.

config MACLAW_GATEWAY_TOKEN
    string "Third-party gateway bearer token"
    default ""
    help
        Optional factory/bootstrap token. Normal deployment pairs by voice and
        stores the returned credential in NVS, so no token is typed on device.

config MACLAW_CLIENT_ID
    string "Stable physical device ID"
    default "esp32s3-pet-001"
    help
        Use an immutable ID per device (for example the chip MAC suffix).

config MACLAW_HEAP_MONITOR
    bool "Log heap and task-stack watermarks once per minute"
    default y
    help
        Periodically logs free/largest-block heap stats (internal + PSRAM)
        and per-task stack high-water marks. Used to validate memory headroom
        for the esp-sr AFE and to size task stacks from measured data.

config MACLAW_AFE_ENABLE
    bool "Enable esp-sr AFE (AEC/NS/AGC) on the wake-word path"
    default y
    help
        Runs the ES7210 microphone through the esp-sr audio front-end
        (acoustic echo cancellation with the speaker signal as reference,
        WebRTC noise suppression and AGC) before MultiNet wake-word
        detection, keeping detection alive during speaker playback as
        barge-in groundwork. If AFE initialisation fails at runtime (for
        example out of internal RAM), the firmware logs the failure and
        falls back to the raw microphone wake-word path, so this option can
        never brick the device. Disable to reclaim the AFE memory.

config MACLAW_POWER_SAVE
    bool "Enable DFS (80-240 MHz) and tickless idle power management"
    default n
    help
        Switches the firmware power-management code paths on: esp_pm_configure
        with dynamic frequency scaling between 80 and 240 MHz, plus APB
        frequency locks around LCD QSPI DMA and the speaker I2S enable points.
        This option alone is not sufficient: it also requires
        CONFIG_PM_ENABLE=y and CONFIG_FREERTOS_USE_TICKLESS_IDLE=y, which are
        deliberately NOT in sdkconfig.defaults so the default build behaviour
        is unchanged. Enable them via idf.py menuconfig (or add them to
        sdkconfig.defaults manually). Must be validated on hardware: audio
        (I2S clock continuity) and LCD (QSPI DMA) timing under reduced CPU
        frequency. Light sleep stays disabled on purpose: the esp-sr AFE feed
        task must run continuously for wake-word AEC, which conflicts with
        light sleep. For a battery product that can drop always-on listening,
        a button-wake deep/light sleep scheme is the alternative.

config MACLAW_BATTERY_ADC_ENABLE
    bool "Enable battery voltage monitoring via ADC"
    default n
    help
        Samples the battery divider once per minute (ADC1 oneshot, 12 dB
        attenuation, assumes a 1:1 divider: Vbat = 2 x Vadc). Logs the level,
        warns below 10% and deep-sleeps below 3% after flushing (no wake
        source is configured; the device stays off until manual reset or
        charger attach). Enable only after confirming the divider GPIO below
        against the board schematic.

config MACLAW_BATTERY_ADC_GPIO
    int "Battery divider GPIO (must map to ADC1)"
    default 4
    depends on MACLAW_BATTERY_ADC_ENABLE

config MACLAW_CONVERSATION_ID
    string "Default conversation ID"
    default "default"
    help
        Kept stable to preserve the MaClawSrv third-party conversation session.

config MACLAW_TEST_BUILD
    bool "Enable test-only firmware hooks (never release)"
    default n
    help
        Enables compile-time test hooks used only to verify fail-closed
        lifecycle paths. This option is intentionally off in every supported
        release sdkconfig and does not create an HTTP, Hub, console, or input
        path for changing a test condition at runtime.

if MACLAW_TEST_BUILD

choice MACLAW_PROVISIONING_FAILURE_INJECTION
    prompt "Provisioning post-save failure injection (test builds only)"
    default MACLAW_PROVISIONING_FAILURE_NONE
    help
        Select exactly one deterministic failure point for the post-save
        restart coordinator. The selected condition is fixed at compile time
        and exists only in a dedicated test artifact. It must never be set in
        a production profile or release package.

    config MACLAW_PROVISIONING_FAILURE_NONE
        bool "None"

    config MACLAW_PROVISIONING_FAILURE_LIFECYCLE_PRIMITIVES
        bool "Restart lifecycle primitive unavailable"

    config MACLAW_PROVISIONING_FAILURE_TASK_CREATE
        bool "Restart coordinator task creation fails"

    config MACLAW_PROVISIONING_FAILURE_TASK_REGISTRY_REGISTER
        bool "Restart coordinator task registry registration fails"

endchoice

config MACLAW_PROVISIONING_TEST_FORCE_PORTAL
    bool "Force the setup portal at boot (test builds only)"
    default n
    help
        Opens the provisioning portal for deterministic hardware-in-the-loop
        verification without modifying the durable force-setup flag. This is
        compiled only when MACLAW_TEST_BUILD is enabled and must never be set
        in a production profile or release package.

config MACLAW_DISPLAY_FAILURE_INITIALIZATION
    bool "Inject a selected display bring-up rollback point (test only)"
    default n
    help
        Enables exactly one compile-time display initialization fault point.
        It requires MACLAW_TEST_BUILD and has no runtime setter, console, Hub
        or production-release path.

config MACLAW_DISPLAY_FAILURE_STAGE
    int "Display bring-up fault stage (1=backlight, 2=SPI, 3=panel IO, 4=panel, 5=panel init)"
    range 1 5
    default 5
    depends on MACLAW_DISPLAY_FAILURE_INITIALIZATION
    help
        After the selected profile has completed this private stage, it returns
        a synthetic failure through its existing rollback label. The numeric
        stage is intentionally an adapter-local acquisition boundary, never a
        Device or Platform API contract.

config MACLAW_COMPACT_RENDERER_FAILURE_INITIALIZATION
    bool "Inject a compact-renderer post-panel rollback point (test only)"
    default n
    help
        Enables exactly one compile-time fault after the shared compact
        renderer has acquired its display hardware. This validates the
        boot-lifetime diagnostic-retain path used by Bread Compact and
        Fangtang-4G. It has no runtime setter, console, Hub or
        production-release path.

config MACLAW_COMPACT_RENDERER_FAILURE_STAGE
    int "Compact-renderer fault stage (1=input, 2=audio, 3=peripheral, 4=scanner semaphore, 5=before scanner task)"
    range 1 5
    default 1
    depends on MACLAW_COMPACT_RENDERER_FAILURE_INITIALIZATION
    help
        The shared compact renderer returns a synthetic failure immediately
        after completing the selected acquisition step. Stage 5 fails before
        publishing the scanner task, matching a task-create failure without
        leaving a synthetic task alive. The stage numbers describe a
        renderer-local lifecycle test seam; they are not Device, Platform or
        profile-adapter API.

config MACLAW_DISPLAY_SERVICE_FAIL_AFTER_INIT
    bool "Fail startup after Display Service publication (test only)"
    default n
    help
        After the shared Display Service task has been created but before App
        UI admission, forces the normal composition-root degraded path. This
        verifies that startup rollback closes Display Service admission and
        joins its task. It does not deinitialize a panel, wait for DMA, or
        provide a runtime display restart path. The condition is compile-time
        only and has no Hub, console, HTTP, input or release-firmware path.

config MACLAW_DISPLAY_SERVICE_STOP_DELAY_MS
    int "Delay terminal Display Service STOP (test only)"
    range 0 30000
    default 0
    depends on MACLAW_DISPLAY_SERVICE_FAIL_AFTER_INIT
    help
        Test-only duration inserted after Display Task consumes its terminal
        STOP record and before it publishes completion. A value longer than
        the composition rollback deadline verifies timeout/late-exit safety:
        admission stays closed and the boot-lifetime STOP record remains
        owned by the delayed task. This is compile-time only; it creates no
        runtime setter, Hub, console, HTTP, input or release-firmware path.

config MACLAW_DISPLAY_SERVICE_REQUEST_DELAY_ONCE_MS
    int "Delay one executing Display Service request (test only)"
    range 0 30000
    default 0
    depends on MACLAW_DISPLAY_SERVICE_FAIL_AFTER_INIT
    help
        Starts one test-owned ordinary scene request, waits until the Display
        Task has begun its private delay, then lets composition rollback queue
        terminal STOP behind that in-flight request. This validates a bounded
        STOP while the task is executing renderer work, rather than only after
        it has consumed STOP. It is compile-time only and creates no runtime
        setter, Hub, console, HTTP, input or release-firmware path.

config MACLAW_DISPLAY_SERVICE_SECONDARY_STOP_DELAY_MS
    int "Delay before a test-only second Display Service stopper"
    range 0 30000
    default 0
    depends on MACLAW_DISPLAY_SERVICE_FAIL_AFTER_INIT
    help
        When nonzero, starts a test-only static worker after Display Service
        publication. It waits this duration, verifies that the primary STOP
        is already in progress, then joins the same terminal STOP generation.
        It cannot create a second STOP record and is absent from release
        builds and all runtime control paths.

config MACLAW_DISPLAY_SERVICE_SECONDARY_STOP_TIMEOUT_MS
    int "Test-only second Display Service stopper timeout"
    range 1 30000
    default 9000
    depends on MACLAW_DISPLAY_SERVICE_SECONDARY_STOP_DELAY_MS > 0
    help
        Bounded join timeout for the test-only secondary stopper. Set it long
        enough to observe a delayed late exit after the primary rollback
        stopper has timed out; this is not a production lifecycle policy.

config MACLAW_DISPLAY_TRANSFER_FENCE_TIMEOUT_ONCE
    bool "Abandon exactly one display transfer fence wait (test only)"
    default n
    help
        Queues one real panel color transaction, then deliberately returns a
        timeout before consuming its completion. The next selected profile
        draw must drain that old transaction before it can submit new pixels.
        This validates late-DMA completion ownership without exposing a
        runtime setter, console, Hub, input, HTTP, Device API or release path.

endif

endmenu
```
