## buddy/firmware/main/Kconfig.projbuild
```kconfig
choice BUDDY_PANEL
    prompt "Buddy display panel"
    default BUDDY_PANEL_ST77916_360
    help
        Selects the physical display the buddy firmware drives. The UI keeps
        its 360x360 logical canvas on both options; a smaller panel receives a
        downsampled copy of that canvas, so layout code stays panel-agnostic.

    config BUDDY_PANEL_ST77916_360
        bool "EchoEar-2ST 360x360 round (ST77916 over QSPI)"
        help
            The original companion screen. QSPI on SPI2_HOST, GPIO 3/4/5/6/7
            plus clock 8, reset 9, backlight 41.

    config BUDDY_PANEL_NV3023_240
        bool "Xingzhi-class 240x240 (NV3023 over SPI)"
        help
            The single-key 0.85-inch module (NV3023A, 240x240 visible window at
            GRAM row 80). SPI on SPI3_HOST, GPIO 9/10/8/14/18 and backlight 13.
            That wiring collides with the EchoEar audio pins, so this option
            also moves the speaker to the module's own I2S pins (DOUT 7 /
            BCLK 15 / WS 16, no MCLK) and skips touch, because GPIO 11/12 are
            this board's 4G modem UART rather than an I2C touch panel.
endchoice

config BUDDY_DISPLAY_SPI_CLOCK_MHZ
    int "Display SPI clock (MHz)"
    range 10 80
    default 20 if BUDDY_PANEL_ST77916_360
    default 40 if BUDDY_PANEL_NV3023_240
    help
        QSPI on the round panel is qualified at 20 MHz; the NV3023 module runs
        at 40 MHz on its short flex. Raising this is the first knob if a build
        shows tearing but is otherwise correct.
```

## esp32-nv3023-lcd-test/sdkconfig.defaults
```kconfig
CONFIG_IDF_TARGET="esp32s3"
CONFIG_ESPTOOLPY_FLASHSIZE_16MB=y
CONFIG_ESPTOOLPY_FLASHMODE_DIO=y
CONFIG_ESPTOOLPY_FLASHFREQ_80M=y
CONFIG_ESP_CONSOLE_USB_SERIAL_JTAG=y
CONFIG_ESP_CONSOLE_SECONDARY_NONE=y
CONFIG_COMPILER_OPTIMIZATION_DEBUG=y
```

## esp32s3-maclaw-client/button-diagnostic/sdkconfig.defaults
```kconfig
CONFIG_ESPTOOLPY_FLASHSIZE_16MB=y
CONFIG_ESP_CONSOLE_USB_SERIAL_JTAG=y
CONFIG_FREERTOS_HZ=1000
```

## esp32s3-maclaw-client/hardware-test/sdkconfig.defaults
```kconfig
CONFIG_ESPTOOLPY_FLASHSIZE_32MB=y
CONFIG_SPIRAM=y
CONFIG_SPIRAM_MODE_OCT=y
CONFIG_SPIRAM_TYPE_AUTO=y
CONFIG_SPIRAM_SPEED_80M=y
CONFIG_SPIRAM_BOOT_INIT=y
CONFIG_SPIRAM_USE_MALLOC=y
CONFIG_ESP_DEFAULT_CPU_FREQ_MHZ_240=y
CONFIG_ESP_CONSOLE_USB_SERIAL_JTAG=y
```

## esp32s3-maclaw-client/main/Kconfig.projbuild
```kconfig
menu "MaClaw ESP32-S3 thin client"

choice MACLAW_BOARD
    prompt "Hardware board"
    default MACLAW_BOARD_ECHOEAR_2ST
    help
        Select the physical board. Existing EchoEar-2ST builds remain the
        default; Bread Compact uses a codec-less I2S microphone and amplifier.

    config MACLAW_BOARD_ECHOEAR_2ST
        bool "EchoEar-2ST (ST77916 + ES7210/ES8311)"

    config MACLAW_BOARD_BREAD_COMPACT_WIFI_LCD
        bool "Bread Compact Wi-Fi LCD (ST7789 + direct I2S audio)"

    config MACLAW_BOARD_FANGTANG_4G
        bool "无名星智 4G / Fangtang 4G (ESP32-S3 dual-network)"
endchoice

config MACLAW_PRODUCT_ID
    string "Stable product identifier"
    default "maclaw-clawmate"
    help
        Machine-readable product family. Keep stable across firmware releases.

config MACLAW_BOARD_ID
    string "Stable board identifier"
    default "bread-compact-wifi-lcd-v1" if MACLAW_BOARD_BREAD_COMPACT_WIFI_LCD
    default "echoear-2st-r8" if MACLAW_BOARD_ECHOEAR_2ST
    default "fangtang-4g-v1" if MACLAW_BOARD_FANGTANG_4G
    help
        Machine-readable physical PCB/display/audio configuration. Change only
        when hardware compatibility changes, not for firmware releases.

config MACLAW_HW_REV
    string "Hardware revision"
    default "1"

config MACLAW_LAYOUT_ID
    string "Flash partition layout identifier"
    default "maclaw-s3-16m-factory-v2"
    help
        Declares the expected partition schema. The host flasher must still
        verify the real partition table read from flash before trusting this.

config MACLAW_COMPAT_ID
    string "Firmware compatibility identifier"
    default "maclaw-clawmate:bread-compact-wifi-lcd-v1:maclaw-s3-16m-factory-v2" if MACLAW_BOARD_BREAD_COMPACT_WIFI_LCD
    default "maclaw-clawmate:echoear-2st-r8:maclaw-s3-16m-factory-v2" if MACLAW_BOARD_ECHOEAR_2ST
    default "maclaw-clawmate:fangtang-4g-v1:maclaw-s3-16m-factory-v2" if MACLAW_BOARD_FANGTANG_4G
    help
        Compact allow-list key used by the flasher after independent chip and
        partition-table verification.

config MACLAW_FIRMWARE_DISPLAY_NAME
    string "Human-readable firmware name"
    default "ClawMate / Bread Compact Wi-Fi LCD" if MACLAW_BOARD_BREAD_COMPACT_WIFI_LCD
    default "ClawMate / EchoEar-2ST R8" if MACLAW_BOARD_ECHOEAR_2ST
    default "ClawMate / 无名星智 4G" if MACLAW_BOARD_FANGTANG_4G

if MACLAW_BOARD_FANGTANG_4G

config MACLAW_FANGTANG_MODEM_UART_PORT
    int "4G modem UART controller"
    range 0 2
    default 1
    help
        UART controller attached to the Cat.1/4G module. Native USB serial
        uses USB Serial/JTAG and does not consume this UART.

config MACLAW_FANGTANG_MODEM_UART_TX_GPIO
    int "ESP32 TX GPIO to 4G modem RX"
    default 12
    help
        The 无名星智 ML307 board routes ESP32 GPIO12 to the modem RX.

config MACLAW_FANGTANG_MODEM_UART_RX_GPIO
    int "ESP32 RX GPIO from 4G modem TX"
    default 11
    help
        The 无名星智 ML307 board routes ESP32 GPIO11 from the modem TX.

config MACLAW_FANGTANG_MODEM_UART_BAUD
    int "4G modem UART baud rate"
    default 921600

config MACLAW_FANGTANG_MODEM_APN
    string "Cellular APN"
    default ""
    help
        Leave empty when the SIM/operator accepts the modem's default PDP
        context; otherwise set the carrier APN.

config MACLAW_FANGTANG_MODEM_POWER_GPIO
    int "Optional 4G modem power-enable GPIO"
    default 21
    help
        无名星智 ML307 board requires GPIO21 high before modem detection.

config MACLAW_FANGTANG_MODEM_POWER_ACTIVE_LEVEL
    int "4G modem power-enable active level"
    range 0 1
    default 1
    depends on MACLAW_FANGTANG_MODEM_POWER_GPIO >= 0

config MACLAW_FANGTANG_MODEM_GUARD_GPIO
    int "4G modem companion-control GPIO"
    default 45
    help
        无名星智 ML307 board initializes GPIO45 as a pulldown output at low
        level before using the modem. Set to -1 only for a revised PCB that
        lacks this companion-control signal.

config MACLAW_FANGTANG_MODEM_GUARD_LEVEL
    int "4G modem companion-control level"
    range 0 1
    default 0
    depends on MACLAW_FANGTANG_MODEM_GUARD_GPIO >= 0

config MACLAW_FANGTANG_DEFAULT_4G
    bool "Use 4G when no network choice has been saved"
    default y
    help
        Mirrors the original ML307 board firmware. A GPIO0 double-click in
        the startup selection window toggles and persists the choice.

endif

config MACLAW_WIFI_SSID
    string "Wi-Fi SSID"
    default ""

config MACLAW_WIFI_PASSWORD
    string "Wi-Fi password"
    default ""

config MACLAW_SERVER_URL
    string "MaClaw Hub base URL"
    default "https://hub.mypapers.top"
    help
        Public Hub URL reachable by the ESP32-S3. Do not include /api/v1.

config MACLAW_GATEWAY_TOKEN
    string "Third-party gateway bearer token"
    default ""
    help
        Optional factory/bootstrap token. Normal deployment pairs by voice and
        stores the returned credential in NVS, so no token is typed on device.

config MACLAW_CLIENT_ID
    string "Stable physical device ID"
    default "esp32s3-pet-001"
    help
        Use an immutable ID per device (for example the chip MAC suffix).

config MACLAW_HEAP_MONITOR
    bool "Log heap and task-stack watermarks once per minute"
    default y
    help
        Periodically logs free/largest-block heap stats (internal + PSRAM)
        and per-task stack high-water marks. Used to validate memory headroom
        for the esp-sr AFE and to size task stacks from measured data.

config MACLAW_AFE_ENABLE
    bool "Enable esp-sr AFE (AEC/NS/AGC) on the wake-word path"
    default y
    help
        Runs the ES7210 microphone through the esp-sr audio front-end
        (acoustic echo cancellation with the speaker signal as reference,
        WebRTC noise suppression and AGC) before MultiNet wake-word
        detection, keeping detection alive during speaker playback as
        barge-in groundwork. If AFE initialisation fails at runtime (for
        example out of internal RAM), the firmware logs the failure and
        falls back to the raw microphone wake-word path, so this option can
        never brick the device. Disable to reclaim the AFE memory.

config MACLAW_POWER_SAVE
    bool "Enable DFS (80-240 MHz) and tickless idle power management"
    default n
    help
        Switches the firmware power-management code paths on: esp_pm_configure
        with dynamic frequency scaling between 80 and 240 MHz, plus APB
        frequency locks around LCD QSPI DMA and the speaker I2S enable points.
        This option alone is not sufficient: it also requires
        CONFIG_PM_ENABLE=y and CONFIG_FREERTOS_USE_TICKLESS_IDLE=y, which are
        deliberately NOT in sdkconfig.defaults so the default build behaviour
        is unchanged. Enable them via idf.py menuconfig (or add them to
        sdkconfig.defaults manually). Must be validated on hardware: audio
        (I2S clock continuity) and LCD (QSPI DMA) timing under reduced CPU
        frequency. Light sleep stays disabled on purpose: the esp-sr AFE feed
        task must run continuously for wake-word AEC, which conflicts with
        light sleep. For a battery product that can drop always-on listening,
        a button-wake deep/light sleep scheme is the alternative.

config MACLAW_BATTERY_ADC_ENABLE
    bool "Enable battery voltage monitoring via ADC"
    default n
    help
        Samples the battery divider once per minute (ADC1 oneshot, 12 dB
        attenuation, assumes a 1:1 divider: Vbat = 2 x Vadc). Logs the level,
        warns below 10% and deep-sleeps below 3% after flushing (no wake
        source is configured; the device stays off until manual reset or
        charger attach). Enable only after confirming the divider GPIO below
        against the board schematic.

config MACLAW_BATTERY_ADC_GPIO
    int "Battery divider GPIO (must map to ADC1)"
    default 4
    depends on MACLAW_BATTERY_ADC_ENABLE

config MACLAW_CONVERSATION_ID
    string "Default conversation ID"
    default "default"
    help
        Kept stable to preserve the MaClawSrv third-party conversation session.

endmenu
```

## esp32s3-maclaw-client/sdkconfig.defaults.fangtang-4g
```kconfig
CONFIG_MACLAW_BOARD_FANGTANG_4G=y
CONFIG_MACLAW_BOARD_ID="fangtang-4g-v1"
CONFIG_MACLAW_COMPAT_ID="maclaw-clawmate:fangtang-4g-v1:maclaw-s3-16m-factory-v2"
CONFIG_MACLAW_FIRMWARE_DISPLAY_NAME="ClawMate / 无名星智 4G"
CONFIG_MACLAW_FANGTANG_MODEM_UART_PORT=1
CONFIG_MACLAW_FANGTANG_MODEM_UART_TX_GPIO=12
CONFIG_MACLAW_FANGTANG_MODEM_UART_RX_GPIO=11
CONFIG_MACLAW_FANGTANG_MODEM_UART_BAUD=921600
CONFIG_MACLAW_FANGTANG_MODEM_POWER_GPIO=21
CONFIG_MACLAW_FANGTANG_MODEM_POWER_ACTIVE_LEVEL=1
CONFIG_MACLAW_FANGTANG_MODEM_GUARD_GPIO=45
CONFIG_MACLAW_FANGTANG_MODEM_GUARD_LEVEL=0
CONFIG_MACLAW_FANGTANG_DEFAULT_4G=y
CONFIG_LWIP_PPP_SUPPORT=y
CONFIG_LWIP_PPP_PAP_SUPPORT=y
```
