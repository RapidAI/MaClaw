## iot-agentos/sdkconfig.defaults.waveshare-amoled-1.75c
```kconfig
CONFIG_IDF_TARGET="esp32s3"
CONFIG_ESPTOOLPY_FLASHSIZE_32MB=y
CONFIG_PARTITION_TABLE_CUSTOM=y
CONFIG_PARTITION_TABLE_CUSTOM_FILENAME="partitions-32m-waveshare.csv"
CONFIG_PARTITION_TABLE_FILENAME="partitions-32m-waveshare.csv"
CONFIG_PARTITION_TABLE_OFFSET=0x8000
CONFIG_PARTITION_TABLE_MD5=y
CONFIG_MACLAW_BOARD_WAVESHARE_S3_TOUCH_AMOLED_1_75C=y
CONFIG_MACLAW_BOARD_ID="waveshare-s3-touch-amoled-1.75c-v1"
CONFIG_MACLAW_LAYOUT_ID="maclaw-s3-32m-factory-v1"
CONFIG_MACLAW_COMPAT_ID="maclaw-clawmate:waveshare-s3-touch-amoled-1.75c-v1:maclaw-s3-32m-factory-v1"
CONFIG_MACLAW_FIRMWARE_DISPLAY_NAME="ClawMate / Waveshare S3 Touch AMOLED 1.75C"
CONFIG_SPIRAM=y
CONFIG_SPIRAM_MODE_OCT=y
CONFIG_SPIRAM_TYPE_AUTO=y
CONFIG_SPIRAM_SPEED_80M=y
CONFIG_SPIRAM_USE_MALLOC=y
CONFIG_SPIRAM_BOOT_INIT=y
CONFIG_SPIRAM_MALLOC_ALWAYSINTERNAL=1024
CONFIG_SPIRAM_MALLOC_RESERVE_INTERNAL=65536
```
